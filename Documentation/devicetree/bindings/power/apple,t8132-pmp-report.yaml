## Documentation/devicetree/bindings/power/apple,t8132-pmp-report.yaml
```yaml
# SPDX-License-Identifier: (GPL-2.0-only OR BSD-2-Clause)
%YAML 1.2
---
$id: http://devicetree.org/schemas/power/apple,t8132-pmp-report.yaml#
$schema: http://devicetree.org/meta-schemas/core.yaml#

title: Apple T8132 PMP telemetry SRAM

maintainers:
  - Eryk Wieliczko <eryk@wieliczko.ninja>

description:
  Read-only telemetry SRAM of the bootloader-started PMP on T8132. The PMP
  provider validates report geometry before exposing GPU thermal and power data.

properties:
  compatible:
    const: apple,t8132-pmp-v2-report
  reg:
    maxItems: 1
  power-domains:
    maxItems: 1

required:
  - compatible
  - reg
  - power-domains

additionalProperties: false
```
